## CMakeLists.txt
```
cmake_minimum_required(VERSION 3.20.0)
find_package(Zephyr REQUIRED HINTS $ENV{ZEPHYR_BASE})

project(nrf54l15udp)

target_sources(app PRIVATE src/main.c)
target_sources(app PRIVATE src/adc.c)
target_sources(app PRIVATE src/network.c)
target_sources(app PRIVATE src/udp.c)
target_sources(app PRIVATE src/usb_console.c)
target_sources(app PRIVATE src/alarm_test.c)
target_sources(app PRIVATE src/fire.c)


target_include_directories(app PRIVATE include)
```

## prj.conf
```kconfig
# Network shell
CONFIG_SHELL=y
CONFIG_OPENTHREAD_SHELL=y
CONFIG_SHELL_ARGC_MAX=26
CONFIG_SHELL_CMD_BUFF_SIZE=416

# Increase Settings storage size
CONFIG_PM_PARTITION_SIZE_SETTINGS_STORAGE=0x8000

# Enable OpenThread features set
CONFIG_OPENTHREAD_NORDIC_LIBRARY_MASTER=y
CONFIG_NET_L2_OPENTHREAD=y

# ------- New 
# Enable OpenThread
CONFIG_OPENTHREAD=y

# Enable flash + settings so datasets can persist
CONFIG_FLASH=y
CONFIG_SETTINGS=y
#---------------

# Generic networking options
CONFIG_NETWORKING=y
CONFIG_GPIO_SHELL=y
CONFIG_GPIO=y

#UDP support
CONFIG_NETWORKING=y
CONFIG_NET_SOCKETS=y
CONFIG_NET_IPV6=y
CONFIG_NET_UDP=y
CONFIG_POSIX_API=y


# ADC support
CONFIG_ADC=y

# Brug printk via USB UART
CONFIG_SERIAL=y
CONFIG_UART_CONSOLE=y
CONFIG_PRINTK=y
CONFIG_STDOUT_CONSOLE=y

#Ip settup
CONFIG_OPENTHREAD_SLAAC=y   
```

## boards/nrf54l15dk_nrf54l15_cpuapp.conf
```kconfig
# Disable the unsupported driver
CONFIG_NRFX_UARTE0=n

# Increase Main and shell stack sizes to avoid stack overflow
# while using CRACEN
CONFIG_MAIN_STACK_SIZE=6144
CONFIG_SHELL_STACK_SIZE=5120

# Workaround required as Zephyr L2 implies usage of NVS backend for settings.
# It should be removed once the proper fix will be applied in Zephyr.
CONFIG_NVS=n
CONFIG_ZMS=y
CONFIG_SETTINGS_ZMS=y

CONFIG_ZMS_LOOKUP_CACHE=y
CONFIG_ZMS_LOOKUP_CACHE_SIZE=512
CONFIG_ZMS_LOOKUP_CACHE_FOR_SETTINGS=y
```

## boards/nrf54l15dk_nrf54l15_cpuapp.overlay
```dts
// restore full RRAM and SRAM space - by default some parts are dedicated to FLPR
&cpuapp_rram {
	reg = <0x0 DT_SIZE_K(1524)>;
};

&cpuapp_sram {
	reg = <0x20000000 DT_SIZE_K(256)>;
	ranges = <0x0 0x20000000  DT_SIZE_K(256)>;
};
```

## src/main.c
```c
#include <zephyr/kernel.h>
#include <zephyr/net/openthread.h>
#include <openthread/thread.h>
#include "network.h"
#include "adc.h" 
#include "usb_console.h"


void main(void)
{
    otInstance *instance = openthread_get_default_instance();
    configure_thread_network_leader(instance);

    if (battery_init() == 0) {
        printk("Dummy battery ADC ready\n");
    } else {
        printk("Dummy battery ADC init failed!\n");
    }

    udp_listener_start(instance);
}
```

## include/adc.h
```c
#ifndef ADC_H
#define ADC_H

typedef enum {
    BAT_GREEN,
    BAT_YELLOW,
    BAT_RED,
    BAT_NONE
} battery_status_t;

int battery_init(void);
battery_status_t get_battery_status(void);
int get_battery_voltage_mv(void);

#endif /* ADC_H_ */
```

## include/alarm.h
```c
#ifndef ALARM_H
#define ALARM_H

void alarm_init(void);
void alarm_trigger(void);

#endif // ALARM_H
```

## include/alarm_test.h
```c
#ifndef ALARM_TEST_H
#define ALARM_TEST_H

void alarm_test_init(void);
void alarm_test_trigger(void);

#endif
```

## include/fire.h
```c
#ifndef FIRE_H
#define FIRE_H

#include <openthread/instance.h>
void fire_init(otInstance *instance);

// --- Tilføjet ved manglende funktions kald
void fire_start(void);
void fire_stop(void);
bool fire_is_active(void);

#endif
```

## include/network.h
```c
#ifndef NETWORK_H
#define NETWORK_H

#include <openthread/instance.h>

void configure_thread_network_leader(otInstance *instance);

#endif
```

## include/udp.h
```c
#ifndef UDP_H
#define UDP_H

#include <openthread/instance.h>

void send_udp_to_all_seds(otInstance *instance);

void udp_listener_start(otInstance *instance);

#endif 
```

## include/usb_console.h
```c
#ifndef USB_CONSOLE_H
#define USB_CONSOLE_H

#include <zephyr/device.h>
#include <zephyr/usb/usb_device.h>
#include <zephyr/drivers/uart.h>

int usb_console_init(void);

#endif // USB_CONSOLE_H
```

## src/adc.c
```c
#include "adc.h"
#include <zephyr/kernel.h>
#include <zephyr/sys/printk.h>

/* Du kan evt. lave en global variabel som "simulerer" en måling */
static int dummy_voltage = 3300;  // 3.3V default
static battery_status_t dummy_status = BAT_GREEN;

int battery_init(void)
{
    printk("Dummy ADC init på nRF54L15\n");
    return 0;
}

battery_status_t get_battery_status(void)
{
    /* Du kan evt. skifte status dynamisk baseret på dummy_voltage */
    if (dummy_voltage > 3000) {
        dummy_status = BAT_GREEN;
    } else if (dummy_voltage > 2600) {
        dummy_status = BAT_YELLOW;
    } else {
        dummy_status = BAT_RED;
    }

    return dummy_status;
}

int get_battery_voltage_mv(void)
{
    /* Returnér bare dummy værdien */
    return dummy_voltage;
}
```

## src/alarm.c
```c
#include "alarm_test.h"
#include <zephyr/kernel.h>
#include <zephyr/device.h>
#include <zephyr/drivers/gpio.h>
#include <zephyr/sys/printk.h>

#define LED_NODE DT_ALIAS(led0)
static const struct gpio_dt_spec led = GPIO_DT_SPEC_GET(LED_NODE, gpios);

void alarm_test_init(void)
{
    if (!device_is_ready(led.port)) {
        printk("Alarm for test - LED device not ready\n");
        return;
    }
    gpio_pin_configure_dt(&led, GPIO_OUTPUT_INACTIVE);
    printk("Alarm test initialized (LED ready)\n");
}

void alarm_test_trigger(void)
{
    printk("Alarm test triggered - LED on!\n");
    gpio_pin_set_dt(&led, 1);

    // Sluk LED efter 10 sekunder
    k_sleep(K_SECONDS(10));

    gpio_pin_set_dt(&led, 0);
    printk("Alarm test ended - LED off\n");
}
```

## src/fire.c
```c
#include <zephyr/kernel.h>
#include <zephyr/drivers/gpio.h>
#include <zephyr/net/socket.h>
#include <zephyr/sys/printk.h>
#include <string.h>
#include <stdbool.h>
#include <errno.h>
#include "fire.h"

// Border Router IPv6-adresse og port
// HUSK at ændre Border Router's adresse
//#define BR_IP6 "fd94:59b5:b7ee:779a:6274:9eaa:9cdd:8073"
#define BR_IP6 "fd78:ee93:e283:a41:ddd7:96ac:ec48:1884"
#define BR_PORT 54321
#define TAG "FIRE"

// --- Hardware konfiguration ---
#define BUTTON_NODE DT_ALIAS(sw0)
#define LED_NODE DT_ALIAS(led0)

static const struct gpio_dt_spec fire_button = GPIO_DT_SPEC_GET(BUTTON_NODE, gpios);
static const struct gpio_dt_spec fire_led = GPIO_DT_SPEC_GET(LED_NODE, gpios);
static struct gpio_callback fire_button_cb;

// --- Global state ---
static otInstance *g_instance = NULL;
static volatile bool fire_active = false;
static struct k_thread fire_thread_data;
K_THREAD_STACK_DEFINE(fire_stack_area, 512);

// --- LED blink ---
void fire_thread(void *a, void *b, void *c)
{
    while (1) {
        if (fire_active) {
            gpio_pin_set_dt(&fire_led, 1);
            k_msleep(300);
            gpio_pin_set_dt(&fire_led, 0);
            k_msleep(300);
        } else {
            k_msleep(100);
        }
    }
}

// --- Start og stop funktioner ---
void fire_start(void)
{
    if (!fire_active) {
        fire_active = true;
        printk("[%s] Fire alarm activated\n", TAG);
    }
}

void fire_stop(void)
{
    fire_active = false;
    gpio_pin_set_dt(&fire_led, 0);
    printk("[%s] Fire alarm stopped (HUSH received)\n", TAG);
}

// --- Knaphåndtering ---
static void fire_button_pressed(const struct device *dev, struct gpio_callback *cb, uint32_t pins)
{
    printk("[%s] Button pressed — sending FIRE!\n", TAG);

    // Start blink lokalt
    fire_start();

    // Send FIRE-besked til Border Router
    int sock = zsock_socket(AF_INET6, SOCK_DGRAM, IPPROTO_UDP);
    if (sock < 0) {
        printk("[%s] Socket create failed: %d\n", TAG, errno);
        return;
    }

    struct sockaddr_in6 dest = {0};
    dest.sin6_family = AF_INET6;
    dest.sin6_port = htons(BR_PORT);
    inet_pton(AF_INET6, BR_IP6, &dest.sin6_addr);

    const char *msg = "fire";
    int ret = zsock_sendto(sock, msg, strlen(msg), 0,
                           (struct sockaddr *)&dest, sizeof(dest));
    if (ret < 0) {
        printk("[%s] UDP send error: %d\n", TAG, errno);
    } else {
        printk("[%s] UDP sent: %s\n", TAG, msg);
    }

    zsock_close(sock);
}

// --- Init ---
void fire_init(otInstance *instance)
{
    g_instance = instance;

    if (!device_is_ready(fire_button.port)) {
        printk("[%s] Button device not ready\n", TAG);
        return;
    }

    if (!device_is_ready(fire_led.port)) {
        printk("[%s] LED device not ready\n", TAG);
        return;
    }

    // Init LED
    gpio_pin_configure_dt(&fire_led, GPIO_OUTPUT_INACTIVE);

    // Init knap
    gpio_pin_configure_dt(&fire_button, GPIO_INPUT);
    gpio_pin_interrupt_configure_dt(&fire_button, GPIO_INT_EDGE_TO_ACTIVE);
    gpio_init_callback(&fire_button_cb, fire_button_pressed, BIT(fire_button.pin));
    gpio_add_callback(fire_button.port, &fire_button_cb);

    // Start blink-tråd
    k_thread_create(&fire_thread_data, fire_stack_area,
                    K_THREAD_STACK_SIZEOF(fire_stack_area),
                    fire_thread, NULL, NULL, NULL,
                    5, 0, K_NO_WAIT);

    printk("[%s] Button interrupt configured on pin %d\n", TAG, fire_button.pin);
}

// --- Aktiv-statusfunktion ---
bool fire_is_active(void)
{
    return fire_active;
}
```

## src/network.c
```c
#include "network.h"
#include <string.h>
#include <zephyr/kernel.h>
#include <openthread/thread.h>
#include <openthread/dataset.h>
#include <openthread/ip6.h>
#include <openthread/error.h>

void configure_thread_network_leader(otInstance *instance)
{
    otOperationalDataset dataset;
    memset(&dataset, 0, sizeof(dataset));

    // Samme netværksnavn som leader
    const char *networkName = "TestNet";
    memcpy(dataset.mNetworkName.m8, networkName, strlen(networkName));
    dataset.mComponents.mIsNetworkNamePresent = true;

    // Samme Network Key
    const uint8_t networkKey[OT_NETWORK_KEY_SIZE] =
        { 0x00, 0x11, 0x22, 0x33, 0x44, 0x55, 0x66, 0x77,
          0x88, 0x99, 0xaa, 0xbb, 0xcc, 0xdd, 0xee, 0xff };
    memcpy(dataset.mNetworkKey.m8, networkKey, sizeof(networkKey));
    dataset.mComponents.mIsNetworkKeyPresent = true;

    // PAN ID
    dataset.mPanId = 0x1234;
    dataset.mComponents.mIsPanIdPresent = true;

    // Channel
    dataset.mChannel = 20;
    dataset.mComponents.mIsChannelPresent = true;

    // Extended PAN ID
    const uint8_t extPanId[OT_EXT_PAN_ID_SIZE] =
        { 0x68, 0xdd, 0x05, 0x98, 0x63, 0x26, 0x54, 0x3b };
    memcpy(dataset.mExtendedPanId.m8, extPanId, sizeof(extPanId));
    dataset.mComponents.mIsExtendedPanIdPresent = true;

    // Mesh Local Prefix
    otIp6Prefix prefix;
    memset(&prefix, 0, sizeof(prefix));
    prefix.mPrefix.mFields.m8[0] = 0xfd;
    prefix.mPrefix.mFields.m8[1] = 0xc2;
    prefix.mPrefix.mFields.m8[2] = 0x26;
    prefix.mPrefix.mFields.m8[3] = 0x5f;
    prefix.mPrefix.mFields.m8[4] = 0x92;
    prefix.mPrefix.mFields.m8[5] = 0x88;
    prefix.mPrefix.mFields.m8[6] = 0x9e;
    prefix.mPrefix.mFields.m8[7] = 0x0a;
    prefix.mLength = 64;
    memcpy(&dataset.mMeshLocalPrefix, &prefix, sizeof(prefix));
    dataset.mComponents.mIsMeshLocalPrefixPresent = true;

    // Active Timestamp (samme struktur som Leader)
    dataset.mActiveTimestamp.mSeconds = 1;
    dataset.mActiveTimestamp.mTicks = 0;
    dataset.mActiveTimestamp.mAuthoritative = 0;
    dataset.mComponents.mIsActiveTimestampPresent = true;

    // Commit dataset
    otDatasetSetActive(instance, &dataset);

    // Konfigurer som Sleepy End Device (SED)
    otLinkModeConfig mode;
    memset(&mode, 0, sizeof(mode));
    mode.mRxOnWhenIdle = false; // Sparer strøm
    mode.mDeviceType   = false; // false = end device (ikke router)
    mode.mNetworkData  = false; // ikke fuld netværksdata
    otThreadSetLinkMode(instance, mode);

    // Poll interval (hvor tit den spørger parent om trafik) i ms
    otLinkSetPollPeriod(instance, 10000);

    // Enable IPv6 + Thread
    otIp6SetEnabled(instance, true);
    otThreadSetEnabled(instance, true);
}
```

## src/udp.c
```c
#include "udp.h"
#include "adc.h"
#include <zephyr/kernel.h>
#include <zephyr/net/socket.h>
#include <string.h>
#include <errno.h>
#include <stdio.h>
#include "fire.h"

#include "alarm_test.h"
#include <zephyr/sys/printk.h>
#include <openthread/message.h>
#include <openthread/udp.h>

#include <openthread/thread.h>
#include <openthread/link.h>
#include <openthread/ip6.h>

#define LISTEN_PORT   12345
#define RESPONSE_PORT 54321

/* Gem instancen i en global statisk pointer */
static otInstance *g_instance = NULL;

static void udp_server_thread(void)
{
    
    int sock;
    struct sockaddr_in6 addr6;
    char buf[128];

    sock = zsock_socket(AF_INET6, SOCK_DGRAM, IPPROTO_UDP);
    if (sock < 0) {
        printk("UDP socket create error: %d\n", errno);
        return;
    }

    memset(&addr6, 0, sizeof(addr6));
    addr6.sin6_family = AF_INET6;
    addr6.sin6_port   = htons(LISTEN_PORT);
    addr6.sin6_addr   = in6addr_any;

    if (zsock_bind(sock, (struct sockaddr *)&addr6, sizeof(addr6)) < 0) {
        printk("UDP bind error: %d\n", errno);
        zsock_close(sock);
        return;
    }

    printk("UDP listener started on port %d\n", LISTEN_PORT);

    while (1) {
        struct sockaddr_in6 src_addr;
        socklen_t addr_len = sizeof(src_addr);

        int len = zsock_recvfrom(sock, buf, sizeof(buf) - 1, 0,
                                 (struct sockaddr *)&src_addr, &addr_len);
        if (len < 0) {
            printk("UDP recv error: %d\n", errno);
            continue;
        }

        buf[len] = '\0';
        printk("UDP received: %s\n", buf);


        // --- ALARM flow ---
        if (strcmp(buf, "ALARMTEST") == 0) {
            alarm_test_trigger();
            continue;
        }

        // --- ALERT_FIRE flow ---
        if (strcmp(buf, "ALARM_START") == 0) {

            if (fire_is_active()) {
                printk("Already active fire alarm – ignoring broadcast\n");
                continue;
            }

            printk("Received ALERT_FIRE broadcast – activating local siren\n");
            fire_start();  // starter blink, men uden at sende 'fire' besked

            // Send 'ALARM_ONLY' svar tilbage til Border Router
            const char *resp_msg = "ALARM_ONLY";
            src_addr.sin6_port = htons(RESPONSE_PORT);   // port 54321
            int ret = zsock_sendto(sock, resp_msg, strlen(resp_msg), 0,
                           (struct sockaddr *)&src_addr, addr_len);

            if (ret < 0)
                printk("UDP send ALARM_ONLY error: %d\n", errno);
            else
                printk("Sent ALARM_ONLY to Border Router\n");

            continue;
        }

        
        // --- HUSH flow ---
        if (strcmp(buf, "HUSH") == 0) {
            fire_stop();   // Kalder din funktion fra fire.c
            printk("UDP received HUSH – stopping fire alarm\n");    
            
            // send bekræftelse tilbage til Border Router
            const char *resp_msg = "HUSH_ACK";
            src_addr.sin6_port = htons(RESPONSE_PORT);   // port 54321
            int ret = zsock_sendto(sock, resp_msg, strlen(resp_msg), 0,
                           (struct sockaddr *)&src_addr, addr_len);
            if (ret < 0) {
                printk("UDP send HUSH_ACK error: %d\n", errno);
            } else {
                printk("Sent HUSH_ACK to Border Router\n");
            }

            continue;
        }


        // --- BREQ flow ---
        if (strstr(buf, "BREQ")) {
            int voltage = get_battery_voltage_mv();
            battery_status_t bat_status = get_battery_status();

            const char *status_str =
                bat_status == BAT_GREEN  ? "GREEN" :
                bat_status == BAT_YELLOW ? "YELLOW" :
                bat_status == BAT_RED    ? "RED" :
                                           "NO BATTERY";

            char mleIdStr[OT_IP6_ADDRESS_STRING_SIZE] = "<none>";
            char extAddrStr[32] = "<none>";
            uint16_t rloc16 = 0xffff;

            if (g_instance) {
                const otIp6Address *mleid = otThreadGetMeshLocalEid(g_instance);
                if (mleid) {
                    otIp6AddressToString(mleid, mleIdStr, sizeof(mleIdStr));
                }

                rloc16 = otThreadGetRloc16(g_instance);

                otExtAddress extAddr;
                otLinkGetFactoryAssignedIeeeEui64(g_instance, &extAddr);
                snprintf(extAddrStr, sizeof(extAddrStr),
                         "%02x:%02x:%02x:%02x:%02x:%02x:%02x:%02x",
                         extAddr.m8[0], extAddr.m8[1], extAddr.m8[2], extAddr.m8[3],
                         extAddr.m8[4], extAddr.m8[5], extAddr.m8[6], extAddr.m8[7]);
            }

            char resp[256];
            snprintf(resp, sizeof(resp),
                     "{ \"voltage\": %d, \"status\": \"%s\", "
                     "\"mleid\": \"%s\", \"rloc16\": \"0x%04x\", "
                     "\"extaddr\": \"%s\" }",
                     voltage, status_str,
                     mleIdStr, rloc16,
                     extAddrStr);

            src_addr.sin6_port = htons(RESPONSE_PORT);
            int ret = zsock_sendto(sock, resp, strlen(resp), 0,
                                   (struct sockaddr *)&src_addr, addr_len);
            if (ret < 0) {
                printk("UDP send response error: %d\n", errno);
            } else {
                printk("Sent response: %s\n", resp);
            }
        }
    }

    zsock_close(sock);
}

void udp_listener_start(otInstance *instance)
{
    g_instance = instance;   /* gem instancen til brug i tråden */

    static K_THREAD_STACK_DEFINE(stack_area, 2048);
    static struct k_thread thread_data;

    k_thread_create(&thread_data,
                    stack_area, K_THREAD_STACK_SIZEOF(stack_area),
                    (k_thread_entry_t)udp_server_thread,
                    NULL, NULL, NULL,
                    7, 0, K_NO_WAIT);
}
```
